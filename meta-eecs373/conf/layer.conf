## meta-eecs373/conf/layer.conf
```bitbake
# We have a conf and classes directory, add to BBPATH
BBPATH .= ":${LAYERDIR}"

# We have recipes-* directories, add to BBFILES
BBFILES += "${LAYERDIR}/recipes-*/*/*.bb \
            ${LAYERDIR}/recipes-*/*/*.bbappend"

BBFILE_COLLECTIONS += "meta-eecs373"
BBFILE_PATTERN_meta-eecs373 = "^${LAYERDIR}/"
BBFILE_PRIORITY_meta-eecs373 = "8"

LAYERDEPENDS_meta-eecs373 = "core"
LAYERSERIES_COMPAT_meta-eecs373 = "kirkstone"
```
